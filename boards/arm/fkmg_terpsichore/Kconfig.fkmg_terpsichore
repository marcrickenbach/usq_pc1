## boards/arm/fkmg_terpsichore/Kconfig.fkmg_terpsichore
```kconfig
# Copyright (c) 2016 Linaro Limited.
# SPDX-License-Identifier: Apache-2.0

config BOARD_FKMG_TERPSICHORE
	select SOC_STM32F405XX
```

## boards/dts/bindings/dac/ti,dac7578.yaml
```yaml
title: Texas Instruments DAC7578 8-channel DAC

description: |
  The DAC7578 is a low-power, 8-Channel, 12-bit digital-to-analog converter with I2C interface.

properties:
  compatible:
    enum:
      - ti,dac7578

  reg:
    description: I2C address of the DAC7578 device
    constraint: true
    type: uint32-array
    category: required

  vin-supply:
    description: Power supply for the DAC (analog reference voltage)
    type: phandle

# https://docs.zephyrproject.org/latest/build/dts/bindings-intro.html
```
